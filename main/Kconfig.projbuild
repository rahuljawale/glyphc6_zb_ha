## main/Kconfig.projbuild
```kconfig
menu "Glyph C6 Monitor Configuration"

    config BLINK_PERIOD_MS
        int "Blink period in milliseconds"
        default 1000
        range 100 10000
        help
            Define the LED blink period in milliseconds.

    config ENABLE_ZIGBEE
        bool "Enable Zigbee support"
        default n
        help
            Enable Zigbee connectivity for the AC power monitor.

    config ZIGBEE_CHANNEL
        int "Zigbee channel"
        depends on ENABLE_ZIGBEE
        default 11
        range 11 26
        help
            Zigbee channel (11-26).

    config ZIGBEE_PANID
        hex "Zigbee PAN ID"
        depends on ENABLE_ZIGBEE
        default 0x1a62
        help
            Zigbee PAN ID in hex format.

endmenu
```

## sdkconfig.defaults
```kconfig
# ESP32-C6 Configuration
CONFIG_IDF_TARGET="esp32c6"

# Flash size (4MB for ESP32-C6-MINI-1)
CONFIG_ESPTOOLPY_FLASHSIZE_4MB=y
CONFIG_ESPTOOLPY_FLASHSIZE="4MB"

# Compiler options
CONFIG_COMPILER_OPTIMIZATION_SIZE=y

# Logging
CONFIG_LOG_DEFAULT_LEVEL_INFO=y
CONFIG_LOG_MAXIMUM_LEVEL_VERBOSE=y

# FreeRTOS
CONFIG_FREERTOS_HZ=1000
CONFIG_FREERTOS_UNICORE=y

# ESP32C6-Specific
CONFIG_ESP32C6_DEFAULT_CPU_FREQ_160=y

# Zigbee Configuration
CONFIG_ZB_ENABLED=y
CONFIG_ZB_ZED=y
CONFIG_ZB_RADIO_NATIVE=y
CONFIG_IEEE802154_ENABLED=y
CONFIG_IEEE802154_RX_BUFFER_SIZE=20

# Partition Table
CONFIG_PARTITION_TABLE_CUSTOM=y
CONFIG_PARTITION_TABLE_CUSTOM_FILENAME="partitions.csv"

# Task Stack Sizes (CRITICAL for Zigbee stability - matches ac_power_monitor)
CONFIG_ESP_SYSTEM_EVENT_TASK_STACK_SIZE=2304
CONFIG_ESP_MAIN_TASK_STACK_SIZE=3584
CONFIG_FREERTOS_IDLE_TASK_STACKSIZE=1536

# CRITICAL: Disable brownout detector (temporary workaround for power issues)
# WARNING: This is a workaround! Fix the root cause by using better power supply
CONFIG_ESP_BROWNOUT_DET=n
```
